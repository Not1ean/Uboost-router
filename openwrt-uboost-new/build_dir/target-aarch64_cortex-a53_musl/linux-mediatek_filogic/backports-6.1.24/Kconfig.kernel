## openwrt-uboost-new/build_dir/target-aarch64_cortex-a53_musl/linux-mediatek_filogic/tmp/openwrt-mediatek-filogic-uboost-3000-initramfs-kernel.bin.its
```
/dts-v1/;

/ {
	description = "ARM64 OpenWrt FIT (Flattened Image Tree)";
	#address-cells = <1>;

	images {
		kernel-1 {
			description = "ARM64 OpenWrt Linux-5.15.150";
			data = /incbin/("/home/notlean/openwrt-uboost/build_dir/target-aarch64_cortex-a53_musl/linux-mediatek_filogic/tmp/openwrt-mediatek-filogic-uboost-3000-initramfs-kernel.bin");
			type = "kernel";
			arch = "arm64";
			os = "linux";
			compression = "lzma";
			load = <0x48000000>;
			entry = <0x48000000>;
			hash-1 {
				algo = "crc32";
			};
			hash-2 {
				algo = "sha1";
			};
		};

		initrd-1 {
			description = "ARM64 OpenWrt uboost-3000 initrd";
			
			data = /incbin/("/home/notlean/openwrt-uboost/build_dir/target-aarch64_cortex-a53_musl/linux-mediatek_filogic/initrd.cpio.xz");
			type = "ramdisk";
			arch = "arm64";
			os = "linux";
			hash-1 {
				algo = "crc32";
			};
			hash-2 {
				algo = "sha1";
			};
		};


		fdt-1 {
			description = "ARM64 OpenWrt uboost-3000 device tree blob";
			
			data = /incbin/("/home/notlean/openwrt-uboost/build_dir/target-aarch64_cortex-a53_musl/linux-mediatek_filogic/image-mt7981b-uboost-3000.dtb");
			type = "flat_dt";
			
			arch = "arm64";
			compression = "none";
			hash-1 {
				algo = "crc32";
			};
			hash-2 {
				algo = "sha1";
			};
		};



	};

	configurations {
		default = "config-1";
		config-1 {
			description = "OpenWrt uboost-3000";
			kernel = "kernel-1";
			fdt = "fdt-1";
			
			
			ramdisk="initrd-1";
		};
		
	};
};
```
